## app/boards/arm/nice_nano/Kconfig
```kconfig
# SPDX-License-Identifier: MIT

config BOARD_ENABLE_DCDC
	bool "Enable DCDC mode"
	select SOC_DCDC_NRF52X
	default y
	depends on (BOARD_NICE_NANO || BOARD_NICE_NANO_V2)

config MOUSE_LAYER_INDEX
	int "Index of mouse layer"
	default 4

config SCROLL_LAYER_INDEX
	int "Index of scroll layer"
	default 5

config MOUSE_LAYER_ACTIVE_MS
	int "Amount of milliseconds the mouse layer will be active after using the trackball"
	default 400
```

## app/boards/shields/tracktyl/Kconfig.defconfig
```kconfig
if SHIELD_TRACKTYL_LEFT

    config ZMK_KEYBOARD_NAME
        default "Tracktyl (Left)"

endif

if SHIELD_TRACKTYL_RIGHT

    config ZMK_KEYBOARD_NAME
        default "Tracktyl (Right)"

    config ZMK_SPLIT_BLE_ROLE_CENTRAL
        default y
		
endif

if SHIELD_TRACKTYL_LEFT || SHIELD_TRACKTYL_RIGHT

    config ZMK_SPLIT
        default y
        
    config ZMK_USB
        default y
endif
```

## app/drivers/sensor/Kconfig
```kconfig
# Copyright (c) 2020 The ZMK Contributors
# SPDX-License-Identifier: MIT

rsource "battery/Kconfig"
rsource "ec11/Kconfig"
rsource "pmw33xx/Kconfig"
rsource "pixart/pmw3360/Kconfig"
rsource "pixart/pmw3389/Kconfig"
```
