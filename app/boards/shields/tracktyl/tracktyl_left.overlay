#include "tracktyl.dtsi" // Notice that the main dtsi files are included in the overlay.

&default_transform {
    col-offset = <0>;
};

&kscan0 {
        col-gpios
            = <&pro_micro 18 GPIO_ACTIVE_HIGH>
		    , <&pro_micro 15 GPIO_ACTIVE_HIGH>
		    , <&pro_micro 14 GPIO_ACTIVE_HIGH>
		    , <&pro_micro 16 GPIO_ACTIVE_HIGH>
		    , <&pro_micro 10 GPIO_ACTIVE_HIGH>
            ;

        row-gpios
            = <&pro_micro 5 (GPIO_ACTIVE_HIGH | GPIO_PULL_DOWN)> // Row A from the schematic file
            , <&pro_micro 6 (GPIO_ACTIVE_HIGH | GPIO_PULL_DOWN)> // Row B from the schematic file
            , <&pro_micro 7 (GPIO_ACTIVE_HIGH | GPIO_PULL_DOWN)> // Row C from the schematic file
            , <&pro_micro 8 (GPIO_ACTIVE_HIGH | GPIO_PULL_DOWN)> // Row D from the schematic file
			, <&pro_micro 9 (GPIO_ACTIVE_HIGH | GPIO_PULL_DOWN)> // Row E from the schematic file
            ;
};
